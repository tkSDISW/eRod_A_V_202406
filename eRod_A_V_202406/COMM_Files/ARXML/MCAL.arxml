AUTOSAR XML (schema 4-2-2)
package /ARPackage
  module config Can: ecuc-def-edition=1.0.0, implementation-config-variant=VARIANT-POST-BUILD, module-description=Can_Impl
    CanConfigSet
      ctrl_ADAS_CAN_ACC (CanController):
        CanWakeupSupport = 0
        CanControllerId = 0
        CanBusoffProcessing = INTERRUPT
        CanControllerTxCancellation = 0
        CanWakeupProcessing = INTERRUPT
        CanTxProcessing = POLLING
        CanControllerActivation = 1
        CanControllerBaseAddress = 4294959104
        CanRxProcessing = POLLING
        CanControllerDefaultBaudrate = Can_ctrl_ADAS_CAN_ACC
        CanCpuClockRef = McuClockReferencePoint
        Can_ctrl_ADAS_CAN_ACC (CanControllerBaudrateConfig): CanControllerBaudRate=1000, CanControllerPropSeg=2, CanControllerSyncJumpWidth=1, CanControllerSeg1=4, CanControllerSeg2=3
      8 x CanHardwareObject, all with CanIdType=STANDARD, CanHandleType=FULL, CanControllerRef=ctrl_ADAS_CAN_ACC, CanMainFunctionRWPeriodRef=CanMainFunctionRWPeriods:
        CanHardwareObject: CanObjectType=TRANSMIT, CanIdValue=261, CanObjectId=2
        CanHardwareObject1: CanObjectType=RECEIVE, CanIdValue=513, CanObjectId=0
        CanHardwareObject2: CanObjectType=RECEIVE, CanIdValue=514, CanObjectId=1
        CanHardwareObject3: CanObjectType=RECEIVE, CanIdValue=600, CanObjectId=3
        CanHardwareObject4: CanObjectType=RECEIVE, CanIdValue=601, CanObjectId=4
        CanHardwareObject5: CanObjectType=RECEIVE, CanIdValue=602, CanObjectId=5
        CanHardwareObject6: CanObjectType=RECEIVE, CanIdValue=603, CanObjectId=6
        CanHardwareObject7: CanIdValue=604, CanObjectId=7, CanObjectType=RECEIVE
    CanGeneral:
      CanIndex = 0
      CanMainFunctionModePeriod = 0.01
      CanVersionInfoApi = 1
      CanHardwareCancellation = 0
      CanChangeBaudrateApi = 1
      CanIdenticalIdCancellation = 0
      CanTimeoutDuration = 0.01
      CanDevErrorDetection = 0
      CanMultiplexedTransmission = 0
      CanSupportTTCANRef = CanIfPrivateCfg
      CanOsCounterRef = OsCounter
      CanMainFunctionRWPeriods: CanMainFunctionReadPeriod=0.025, CanMainFunctionWritePeriod=0.025
    GeneralPublishedInformation: ArVersionMajor=4, ArVersionMinor=2, ArVersionRev=2, SwVersionMajor=2, SwVersionMinor=1, SwVersionPatch=0, ModuleId=80, VendorId=31
  module config Mcu: ecuc-def-edition=1.0.0, implementation-config-variant=VARIANT-POST-BUILD
    McuGeneralConfiguration: McuNoPll=1, McuPerformResetApi=(unset), McuInitClock=1, McuVersionInfoApi=(unset), McuDevErrorDetect=(unset), McuGetRamStateApi=(unset)
    McuModuleConfiguration: McuRamSectors=(unset), McuClockSrcFailureNotification=(unset), McuNumberOfMcuModes=(unset)
      McuModeSettingConf: McuMode=0
      McuClockSettingConfig: McuClockSettingId=1
        McuClockReferencePoint: McuClockReferencePointFrequency=4.0E7
