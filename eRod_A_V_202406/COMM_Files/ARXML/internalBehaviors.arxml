AUTOSAR XML (schema 4-2-2)
package /ComponentType/ApplicationSwComponentType
  application sw component type appswc_ACC_CONTROLLER
    behavior IB_appswc_ACC_CONTROLLER: data-type-mapping=id_data_type_map_set_0002, handle-termination-and-restart=NO-SUPPORT
      timing event TimingEvent: start-on-event=brakeCheck, period=0.01
      timing event TimingEvent1: start-on-event=brakeCompute, period=0.01
      timing event TimingEvent2: start-on-event=velDifCompute, period=0.01
      explicit-inter-runnable-variables:
        data irv_difFac: type=dt_id_compu_meth_0001_UINT5
        data irv_if_velDif: type=dt_id_compu_meth_0001_BOOL
        data irv2_if_AH: type=dt_id_compu_meth_0001_BOOL
      runnable brakeCheck
        data-read-access:
          access AccVel_set: accessed-variable=ReceiverOfAccCtrl2.AccStateTargetSet_vdp
          access posVel_in: accessed-variable=ReceiverOfAccCtrl3.PositionVelocity_vdp
        written-local-variables:
          access velDiff: accessed-variable=irv_if_velDif
      runnable velDifCompute
        data-read-access:
          access posVel_in: accessed-variable=ReceiverOfAccCtrl3.PositionVelocity_vdp
          access AccVel_set_in: accessed-variable=ReceiverOfAccCtrl2.AccStateTargetSet_vdp
        read-local-variables:
          access velDiff_in: accessed-variable=irv_if_velDif
        written-local-variables:
          access difFactor: accessed-variable=irv_difFac
          access AccsetHigh: accessed-variable=irv2_if_AH
      runnable brakeCompute
        data-read-access:
          access AccVel_set: accessed-variable=ReceiverOfAccCtrl2.AccStateTargetSet_vdp
        data-write-access:
          access brakeSwitch3: accessed-variable=SenderOfAccCtrl1.BrakeSwitch3_vdp
        read-local-variables:
          access difFactor_in: accessed-variable=irv_difFac
          access noHigh_002: accessed-variable=irv2_if_AH
  application sw component type appswc_ADAS_RaiseDistanceWarning
    behavior IB_appswc_ADAS_RaiseDistanceWarning: data-type-mapping=DTMS_DataTypeMappingSet, handle-termination-and-restart=NO-SUPPORT
  application sw component type appswc_AudioBase
    behavior IB_appswc_AudioBase: data-type-mapping=DTMS_DataTypeMappingSet, handle-termination-and-restart=NO-SUPPORT
  application sw component type appswc_DetectDistance
    behavior IB_appswc_DetectDistance: data-type-mapping=DTMS_DataTypeMappingSet, handle-termination-and-restart=NO-SUPPORT
  application sw component type appswc_F1_Powertrain
    behavior IB_appswc_F1_Powertrain: data-type-mapping=DTMS_DataTypeMappingSet, handle-termination-and-restart=NO-SUPPORT
  application sw component type appswc_F2_Chassis
    behavior IB_appswc_F2_Chassis: data-type-mapping=DTMS_DataTypeMappingSet, handle-termination-and-restart=NO-SUPPORT
  application sw component type appswc_F3_Safety
    behavior IB_appswc_F3_Safety: data-type-mapping=DTMS_DataTypeMappingSet, handle-termination-and-restart=NO-SUPPORT
  application sw component type appswc_F4_MMI
    behavior IB_appswc_F4_MMI: data-type-mapping=DTMS_DataTypeMappingSet, handle-termination-and-restart=NO-SUPPORT
  application sw component type appswc_F5_BodyA
    behavior IB_appswc_F5_BodyA: data-type-mapping=DTMS_DataTypeMappingSet, handle-termination-and-restart=NO-SUPPORT
  application sw component type appswc_F5_BodyB
    behavior IB_appswc_F5_BodyB: data-type-mapping=DTMS_DataTypeMappingSet, handle-termination-and-restart=NO-SUPPORT
  application sw component type appswc_F5_BodyC
    behavior IB_appswc_F5_BodyC: data-type-mapping=DTMS_DataTypeMappingSet, handle-termination-and-restart=NO-SUPPORT
  application sw component type appswc_F6_ADAS
    behavior IB_appswc_F6_ADAS: data-type-mapping=id_data_type_map_set_0002, handle-termination-and-restart=NO-SUPPORT
  application sw component type appswc_MaintainDistance
    behavior IB_appswc_MaintainDistance: data-type-mapping=id_data_type_map_set_0002, handle-termination-and-restart=NO-SUPPORT
  application sw component type appswc_ObstacleDetection
    behavior IB_appswc_ObstacleDetection: data-type-mapping=DTMS_DataTypeMappingSet, handle-termination-and-restart=NO-SUPPORT
  application sw component type appswc_PowerTrain_Control
    behavior IB_appswc_PowerTrain_Control: data-type-mapping=DTMS_DataTypeMappingSet, handle-termination-and-restart=NO-SUPPORT
  application sw component type appswc_Radar
    behavior IB_appswc_Radar: data-type-mapping=DTMS_DataTypeMappingSet, handle-termination-and-restart=NO-SUPPORT
  application sw component type appswc_Sensor_Fusion_Software
    behavior IB_appswc_Sensor_Fusion_Software: data-type-mapping=DTMS_DataTypeMappingSet, handle-termination-and-restart=NO-SUPPORT
  application sw component type appswc_VehicleStatus
    behavior IB_appswc_VehicleStatus: data-type-mapping=DTMS_DataTypeMappingSet, handle-termination-and-restart=NO-SUPPORT
  application sw component type appswc_Warn_LCD
    behavior IB_appswc_Warn_LCD: data-type-mapping=DTMS_DataTypeMappingSet, handle-termination-and-restart=NO-SUPPORT
  swc implementation Impl_appswc_ACC_CONTROLLER: programming-language=C, sw-version=1.0.0, vendor-id=31, behavior=IB_appswc_ACC_CONTROLLER
    code-descriptors:
      code Code_appswc_ACC_CONTROLLER: artifact-descriptors=autosar-engineering-object={short-label=appswc_ACC_CONTROLLER, category=SWSRC}
    resource consumption ResConsumption
  swc implementation Impl_appswc_F6_ADAS: programming-language=C, sw-version=1.0.0, vendor-id=31, behavior=IB_appswc_F6_ADAS
    code-descriptors:
      code Code_appswc_F6_ADAS: artifact-descriptors=autosar-engineering-object={short-label=appswc_F6_ADAS, category=SWSRC}
    resource consumption ResConsumption
  swc implementation Impl_appswc_MaintainDistance: programming-language=C, sw-version=1.0.0, vendor-id=31, behavior=IB_appswc_MaintainDistance
    code-descriptors:
      code Code_appswc_MaintainDistance: artifact-descriptors=autosar-engineering-object={short-label=appswc_MaintainDistance, category=SWSRC}
    resource consumption ResConsumption
