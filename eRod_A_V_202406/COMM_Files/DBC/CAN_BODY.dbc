// *************************************************************************** *
// *                                                                           *
// * Description:         CANDB File                                           *
// * Generated at:        2023-03-30 11:45                                     *
// * System:              ComSystem                                            *
// * Network:             CAN_BODY                                             *
// *                                                                           *
// *************************************************************************** *

VERSION "CAN_BODY"

NS_ :

BS_ :

BU_ :  ADAS

BO_ 262 ADAS_BODY_Frame : 8 ADAS
 SG_ Body_ADAS_02 : 7|20@0+ (1,0) [0|1048575] "" Vector__XXX
 SG_ Body_ADAS_09 : 19|20@0+ (1,0) [0|1048575] "" Vector__XXX

// Attribute definitions
BA_DEF_  "Baudrate" FLOAT 1000 1000000; // [bps]
BA_DEF_  "BusType" STRING;
BA_DEF_  "DBName" STRING;
BA_DEF_  "ProtocolType" STRING;
BA_DEF_ BO_ "GenMsgCycleTime" FLOAT 0 300000; // [ms]
BA_DEF_ BO_ "GenMsgSendType" ENUM "cyclic","spontaneous","cyclicIfActive","spontaneousWithDelay","cyclicAndSpontaneous","cyclicAndSpontaneousWithDelay","IfActive","NoMsgSendType"; // [us]
BA_DEF_ BO_ "GenMsgStartDelayTime" FLOAT 0 300000; // [ms]
BA_DEF_ SG_ "GenSigSendType" ENUM "Cyclic","OnWrite","OnWriteWithRepetition","OnChange","OnChangeWithRepetition","IfActive","IfActiveWithRepetition","NoSigSendType";
BA_DEF_ SG_ "GenSigStartValue" FLOAT -1.7976931348623157E308 18446744073709551615;

BA_DEF_DEF_ "BusType" "";
BA_DEF_DEF_ "DBName" "";
BA_DEF_DEF_ "ProtocolType" "";
BA_DEF_DEF_ "GenSigStartValue" 0;
BA_DEF_DEF_ "GenSigSendType" "Cyclic";

// Network
BA_ "Baudrate" 500000;
BA_ "BusType" "CAN";
BA_ "DBName" "CAN_BODY";
BA_ "ProtocolType" "CAN";
// Frame: ADAS_BODY_Frame
BA_ "GenMsgCycleTime" BO_ 262 10.000;
BA_ "GenMsgSendType" BO_ 262 0;
BA_ "GenMsgStartDelayTime" BO_ 262 0.000;
